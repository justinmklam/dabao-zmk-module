## boards/shields/dabao/Kconfig.defconfig
```kconfig
if SHIELD_DABAO

# Name must be less than 16 characters long!
config ZMK_KEYBOARD_NAME
    default "dabao"

config ZMK_KSCAN_MATRIX_POLLING
    default y

config ZMK_POINTING
    default y

endif
```

## boards/shields/dabao/Kconfig.shield
```kconfig
# No whitespace after the comma or in your keyboard name!
config SHIELD_DABAO
    def_bool $(shields_list_contains,dabao)
```

## config/west.yml
```yaml
manifest:
  remotes:
    - name: zmkfirmware
      url-base: https://github.com/zmkfirmware
    - name: badjeff
      url-base: https://github.com/badjeff
  projects:
    - name: zmk
      remote: zmkfirmware
      import: app/west.yml
      revision: ac7f75b8

    # Updated fork of infused-kim's initial work
    - name: kb_zmk_ps2_mouse_trackpoint_driver
      remote: badjeff
      revision: 2df4d6d

  self:
    path: config
```
